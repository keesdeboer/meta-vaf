## beaglebone-bsp/conf/layer.conf
```bitbake
# We might have a conf and classes directory, append to BBPATH
BBPATH .= ":${LAYERDIR}"

# We have a recipes directory, add to BBFILES
BBFILES += "${LAYERDIR}/recipes*/*/*.bb ${LAYERDIR}/recipes*/*/*.bbappend"

BBFILE_COLLECTIONS += "meta-beaglebone-bsp"
BBFILE_PATTERN_meta-beaglebone-bsp := "^${LAYERDIR}/"
BBFILE_PRIORITY_meta-beaglebone-bsp = "8"
```

## conf/layer.conf
```bitbake
# We have a conf and classes directory, append to BBPATH
BBPATH .= ":${LAYERDIR}"

BBFILES += "${LAYERDIR}/recipes*/*/*.bb ${LAYERDIR}/recipes*/*/*.bbappend"
BBFILE_COLLECTIONS += "meta-vaf"
BBFILE_PATTERN_meta-vaf := "^${LAYERDIR}/"
BBFILE_PRIORITY_meta-vaf = "8"
```

## meta-pem3/conf/layer.conf
```bitbake
# We have a conf and classes directory, append to BBPATH
BBPATH .= ":${LAYERDIR}"

BBFILES += "${LAYERDIR}/recipes*/*/*.bb ${LAYERDIR}/recipes*/*/*.bbappend"
BBFILE_COLLECTIONS += "meta-pem3"
BBFILE_PATTERN_meta-pem3 := "^${LAYERDIR}/"
BBFILE_PRIORITY_meta-pem3 = "8"
```
